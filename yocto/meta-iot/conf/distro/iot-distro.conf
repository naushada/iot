## yocto/meta-iot/conf/distro/iot-distro.conf
```bitbake
# iot-distro — the distribution policy for the iot LwM2M/CoAP device image.
#
# WHY a custom distro instead of building the `poky` reference distro:
#   * poky is Yocto's *reference* distro — it advertises itself as such and is
#     explicitly "not for production". Owning our own DISTRO stops that class of
#     nag and gives us ONE file that defines distro policy, instead of the same
#     policy scattered across entrypoint.sh / kas-iot.yml local.conf headers.
#   * A DISTRO is the correct home for *capability* policy: init manager, package
#     format, and DISTRO_FEATURES (the wifi/bluetooth/systemd/... switches).
#     It is NOT the home for build-host or per-build concerns — thread counts,
#     rm_work, sstate mirrors, MACHINE, IOT_AB. Those stay in entrypoint.sh.
#
# Selection: builds set `DISTRO = "iot-distro"` in local.conf (entrypoint.sh and
# kas-iot.yml do this). bitbake then resolves this file via BBPATH — meta-iot's
# layer.conf appends LAYERDIR to BBPATH, so conf/distro/iot-distro.conf is found.
#
# Strategy: derive from poky (require it below), then override only what we own.
# v1 is behaviourally identical to the old poky build except for the rename and
# the folded-in INIT_MANAGER/PACKAGE_CLASSES — so the first image boots exactly
# like today. DISTRO_FEATURES trimming is staged (commented) at the bottom and
# applied only after a verified boot, one feature at a time.

# ── Inherit poky's behaviour as the baseline ───────────────────────────
# Pulls in the default DISTRO_FEATURES, SANITY_TESTED_DISTROS, SDK vars, the
# preferred-version pins, etc. Everything below overrides on top of this.
require conf/distro/poky.conf

# ── Distro identity ────────────────────────────────────────────────────
# Override AFTER the require (poky.conf sets DISTRO = "poky").
DISTRO = "iot-distro"
DISTRO_NAME = "IoT Distro"
MAINTAINER = "iot <naushad.dln@gmail.com>"

# DISTRO_VERSION is deliberately left as poky's (the Yocto release string) so it
# tracks the upstream base and does NOT become a 4th product-version spot to bump
# at release-cut time (/VERSION + iot_git.bb PV + iot-bundle.bb PV already exist).

# ── Distro capability policy (folded in from local.conf) ───────────────
# systemd as init manager — required for DynamicUser=, RuntimeDirectory=,
# StateDirectory= used throughout the iot units. This is distro identity, not a
# per-build knob, so it lives here now (was written to local.conf per build).
INIT_MANAGER = "systemd"

# .ipk packages → on-target opkg + a flat ipk feed under tmp/deploy/ipk, so
# iot-*.ipk can be scp'd and `opkg install`ed over ssh, and the OTA bundle can
# pick .ipk files up. (Poky defaults to rpm; without this the ipk feed the
# deploy scripts reference is never built.) Also distro identity.
PACKAGE_CLASSES = "package_ipk"

# ── DISTRO_FEATURES trim ───────────────────────────────────────────────
# Drop capabilities nothing in the stack uses. The device is HEADLESS, so the
# three display features (x11/wayland/opengl) are dead weight; the three legacy
# radio/bus features (3g/nfc/pcmcia) gate recipes we never install — our
# cellular path is the custom WP7702 AT/QMI client, NOT ofono's `3g` feature.
#
# Deliberately KEPT (bring-up depends on them): wifi + bluetooth (rpidistro
# firmware for the RPi3B onboard radio), systemd, usbhost, ipv4/ipv6, seccomp.
#
# These six are not backfilled features, so `:remove` is the right operator.
# Still pending an HW boot — if the board comes up degraded, bisect by
# commenting features back one at a time and reflashing.
DISTRO_FEATURES:remove = "x11 wayland opengl 3g nfc pcmcia"
```

## yocto/meta-iot/conf/layer.conf
```bitbake
# meta-iot — Yocto layer for the iot LwM2M 1.1.1 stack
#
# Provides recipes for lwm2m, ds-server, ds-cli, openvpn-client,
# net-router, wifi-client, and their third-party dependencies
# (ACE_TAO 7.0.0, tinydtls, mongo-c/cxx drivers).
#
# Layer dependencies: poky (core) + meta-openembedded (openembedded-layer).
# Target Yocto release: Scarthgap (5.0 LTS).

# Add this layer's root to BBPATH. Without it the layer still parses (BBFILES
# below uses absolute ${LAYERDIR} paths), but anything that searches BBPATH
# misses us — notably wic's WKS_SEARCH_PATH ("<BBPATH>/wic"), so a wks shipped
# in meta-iot/wic/ (the IOT_AB=1 iot-ab.wks.in) is "not found" at do_image_wic.
BBPATH .= ":${LAYERDIR}"

BBFILE_COLLECTIONS += "iot"
BBFILE_PATTERN_iot := "^${LAYERDIR}/"
BBFILE_PRIORITY_iot = "6"

BBFILES += "${LAYERDIR}/recipes-*/*/*.bb \
            ${LAYERDIR}/recipes-*/*/*.bbappend"

# RAUC A/B recipes (rauc-conf.bbappend + update-bundle.bb) are parsed ONLY when
# the meta-rauc layer (collection "rauc") is present — i.e. an IOT_AB=1 build.
# Without this guard those appends would dangle on a default build (no
# meta-rauc → bitbake errors on an append with no matching recipe).
BBFILES_DYNAMIC += " \
    rauc:${LAYERDIR}/dynamic-layers/rauc/recipes-*/*/*.bb \
    rauc:${LAYERDIR}/dynamic-layers/rauc/recipes-*/*/*.bbappend \
"

LAYERDEPENDS_iot = "core openembedded-layer"
LAYERSERIES_COMPAT_iot = "scarthgap"

LICENSE_PATH += "${LAYERDIR}/recipes-iot/lwm2m/files"
```
